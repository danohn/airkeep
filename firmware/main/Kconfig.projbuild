## firmware/main/Kconfig.projbuild
```kconfig
menu "Airkeep connection"
config AIRKEEP_DISPLAY_PAIRING
    bool
    default y
    select LV_USE_QRCODE
config AIRKEEP_WIFI_SSID
    string "Wi-Fi SSID (2.4 GHz)"
    default ""
config AIRKEEP_WIFI_PASSWORD
    string "Wi-Fi password"
    default ""
config AIRKEEP_RELAY_URL
    string "Airkeep relay HTTPS URL (including port, if needed)"
    default "https://dashboard.airkeep.io"
    help
        Defaults to Airkeep hosted. For self-hosting, use your relay origin,
        for example https://airkeep.example.com:8443. The server certificate
        and hostname are verified with the ESP-IDF public CA bundle.
config AIRKEEP_AMS_ID
    string "AMS identifier"
    default "0"
endmenu
```
